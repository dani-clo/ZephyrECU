## components/can_comm/Kconfig
```kconfig
menuconfig CAN_COMM
	bool "ZephyrECU can_comm component"
	depends on CAN_IF
	depends on SYS_CLOCK_TICKS_PER_SEC >= 1000
	help
	  DBC-configured application signals and one bounded TX scheduler.

if CAN_COMM

config CAN_COMM_MAX_CALLBACKS
	int "Maximum callbacks per RX PDU or signal"
	default 4
	range 1 16

config CAN_COMM_STACK_SIZE
	int "Communication scheduler stack size"
	default 2048
	range 1024 16384

config CAN_COMM_PRIORITY
	int "Communication scheduler preemptive priority"
	default 6
	range 0 14

endif
```

## components/can_if/Kconfig
```kconfig
menuconfig CAN_IF
	bool "ZephyrECU CAN interface"
	depends on CAN
	help
	  Single Classical CAN controller owner with bounded RX dispatch and TX.

if CAN_IF

config CAN_IF_RX_QUEUE_SIZE
	int "RX frame queue capacity"
	default 32
	range 1 256

config CAN_IF_MAX_ROUTES
	int "Maximum distinct CAN ID/type routes"
	default 8
	range 1 64

config CAN_IF_MAX_CONSUMERS
	int "Maximum callbacks per route"
	default 4
	range 1 16

config CAN_IF_DISPATCH_STACK_SIZE
	int "RX dispatcher stack size"
	default 2048
	range 1024 16384

config CAN_IF_DISPATCH_PRIORITY
	int "RX dispatcher preemptive priority"
	default 5
	range 0 14

endif
```

## components/diag_uds/Kconfig
```kconfig
menuconfig DIAG_UDS
	bool "ZephyrECU UDS server with bundled isotp-c"
	depends on CAN_IF && !ISOTP
	depends on SYS_CLOCK_TICKS_PER_SEC >= 1000

if DIAG_UDS

config DIAG_UDS_PHYSICAL_RX_ID
	hex "Physical request CAN ID"
	default 0x7e0
	range 0x0 0x7ff

config DIAG_UDS_PHYSICAL_TX_ID
	hex "Physical response CAN ID"
	default 0x7e8
	range 0x0 0x7ff

config DIAG_UDS_FUNCTIONAL_RX_ID
	hex "Functional request CAN ID"
	default 0x7df
	range 0x0 0x7ff

config DIAG_UDS_RX_QUEUE_SIZE
	int "Diagnostic RX queue capacity"
	default 32
	range 1 256

config DIAG_UDS_MAX_HANDLERS
	int "Maximum handlers per DID/RID registry"
	default 8
	range 1 32

config DIAG_UDS_STACK_SIZE
	int "Diagnostic worker stack size"
	default 4096
	range 2048 16384

config DIAG_UDS_PRIORITY
	int "Diagnostic worker preemptive priority"
	default 4
	range 0 14

config DIAG_UDS_POLL_MS
	int "Diagnostic polling interval (ms)"
	default 1
	range 1 2

endif
```

## components/nvm/Kconfig
```kconfig
menuconfig ECU_NVM
	bool "ZephyrECU synchronous persistent data manager (NVS)"
	select FLASH
	select FLASH_MAP
	select FLASH_PAGE_LAYOUT
	select NVS
	select NVS_DATA_CRC
	help
	  Requires an ecu-nvm Devicetree alias to an exclusive fixed partition
	  and a working Zephyr flash driver. No automatic formatting on errors.

if ECU_NVM

config ECU_NVM_MAX_PAYLOAD_SIZE
	int "Maximum persistent record payload bytes"
	default 256
	range 1 4096
	help
	  One shared serialized scratch buffer, no allocation. Must fit the
	  partition erase page with the envelope, NVS metadata and alignment.

endif
```

## components/task_manager/Kconfig
```kconfig
menuconfig ECU_TASK_MANAGER
	bool "ZephyrECU application task manager"
	help
	  Static lightweight application callbacks on one explicitly started thread.

if ECU_TASK_MANAGER

config ECU_TASK_MANAGER_STACK_SIZE
	int "Application task thread stack size"
	default 2048
	range 1024 32768
	help
	  Shared by the deepest callback call chain, including library calls.
	  Measure stack headroom on the target and increase for application needs.

config ECU_TASK_MANAGER_PRIORITY
	int "Application task thread preemptive priority"
	default 7
	range 0 14
	help
	  Default is less urgent than UDS (4), CAN RX (5), and CAN TX (6).
	  Recheck relative priorities when changing any component configuration.

endif
```

## tests/can_comm/testcase.yaml
```yaml
tests:
  zephyrecu.can_comm.contract:
    platform_allow:
      - native_sim
    integration_platforms:
      - native_sim
    tags:
      - can
      - can_comm
    timeout: 30
```

## tests/can_if/testcase.yaml
```yaml
tests:
  zephyrecu.can_if.contract:
    platform_allow:
      - native_sim
    integration_platforms:
      - native_sim
    tags:
      - can
      - can_if
    timeout: 30
```

## tests/diag_uds/testcase.yaml
```yaml
tests:
  zephyrecu.diag_uds.contract:
    platform_allow:
      - native_sim
    integration_platforms:
      - native_sim
    tags:
      - can
      - uds
    timeout: 30
```

## tests/nvm/testcase.yaml
```yaml
tests:
  zephyrecu.nvm.contract:
    platform_allow:
      - native_sim
    integration_platforms:
      - native_sim
    tags:
      - nvm
    timeout: 30
```

## tests/nvm_app/testcase.yaml
```yaml
tests:
  zephyrecu.nvm.application:
    platform_allow:
      - native_sim
    integration_platforms:
      - native_sim
    tags:
      - nvm
      - task_manager
    timeout: 30
```

## tests/nvm_backend/testcase.yaml
```yaml
tests:
  zephyrecu.nvm.backend:
    platform_allow:
      - native_sim
    integration_platforms:
      - native_sim
    tags:
      - nvm
    timeout: 30
```

## tests/nvm_reboot/testcase.yaml
```yaml
tests:
  zephyrecu.nvm.reboot:
    platform_allow:
      - native_sim
    integration_platforms:
      - native_sim
    tags:
      - nvm
    expect_reboot: true
    timeout: 30
```

## tests/task_manager/testcase.yaml
```yaml
tests:
  zephyrecu.task_manager.contract:
    platform_allow:
      - native_sim
    integration_platforms:
      - native_sim
    tags:
      - task_manager
      - can_comm
    timeout: 30
```
