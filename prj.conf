## CMakeLists.txt
```
cmake_minimum_required(VERSION 3.20.0)

list(APPEND EXTRA_ZEPHYR_MODULES
  ${CMAKE_CURRENT_SOURCE_DIR}/components/can_if
  ${CMAKE_CURRENT_SOURCE_DIR}/components/can_comm
  ${CMAKE_CURRENT_SOURCE_DIR}/components/nvm
  ${CMAKE_CURRENT_SOURCE_DIR}/components/task_manager
  ${CMAKE_CURRENT_SOURCE_DIR}/components/diag_uds
)
find_package(Zephyr REQUIRED HINTS $ENV{ZEPHYR_BASE})
project(ZephyrECU LANGUAGES C)

set_property(TARGET app PROPERTY C_STANDARD 17)
set_property(TARGET app PROPERTY C_STANDARD_REQUIRED ON)
target_sources(app PRIVATE src/main.c app/src/app_led.c app/src/app_diag.c app/src/app_tasks.c app/src/app_led_config.c)
target_include_directories(app PRIVATE app/include)
target_compile_options(app PRIVATE -Wall -Wextra)
```

## Kconfig
```
mainmenu "ZephyrECU"

source "Kconfig.zephyr"

# Enable persistence only where the application has a configured Zephyr flash
# device/partition. Other boards must opt in and provide an ecu-nvm alias.
config ECU_NVM
	default y if BOARD_NATIVE_SIM || BOARD_ARDUINO_UNO_Q

if ECU_NVM
config APP_LED_PERSIST_STACK_SIZE
	int "LED configuration persistence worker stack size"
	default 2048
	range 1024 16384
config APP_LED_PERSIST_PRIORITY
	int "LED configuration persistence worker preemptive priority"
	default 8
	range 0 14
endif
```

## west.yml
```
manifest:
  remotes:
    - name: zephyrproject-rtos
      url-base: https://github.com/zephyrproject-rtos
    - name: driftregion
      url-base: https://github.com/driftregion
  projects:
    - name: zephyr
      remote: zephyrproject-rtos
      revision: v4.4.2
      import:
        name-allowlist:
          - cmsis_6
          - hal_nxp
          - hal_stm32
          - hal_infineon
    - name: iso14229
      remote: driftregion
      revision: 8a7eb23d6ab9d52f66ce36b07ba456613709c78e
      path: modules/lib/iso14229
  self:
    path: ZephyrECU
```

## prj.conf
```kconfig
CONFIG_CAN=y
CONFIG_ISOTP=n
CONFIG_CAN_IF=y
CONFIG_CAN_COMM=y
CONFIG_DIAG_UDS=y
CONFIG_GPIO=y
CONFIG_LOG=y
CONFIG_LOG_DEFAULT_LEVEL=3
CONFIG_CONSOLE=y
CONFIG_PRINTK=y
CONFIG_SYS_CLOCK_TICKS_PER_SEC=1000
CONFIG_ECU_TASK_MANAGER=y
```

## boards/arduino_uno_q.conf
```kconfig
# Preserve the existing direct-boot image origin (offset 0). The default board
# ignores its chosen code partition unless USE_DT_CODE_PARTITION is enabled.
# Bound the linked image before the existing storage partition at offset E0000.
CONFIG_FLASH_LOAD_SIZE=0xe0000
```

## boards/arduino_uno_q.overlay
```dts
/* SPDX-License-Identifier: Apache-2.0 */

/ {
	chosen {
		zephyr,canbus = &fdcan1;
	};
};

/* D5 (PA11): RX, D4 (PA12): TX. Connect an external CAN transceiver.
 * These pins are shared with USB OTG FS, which the board leaves disabled.
 */
&fdcan1 {
	clocks = <&rcc STM32_CLOCK(APB1_2, 9)>,
		 <&rcc STM32_SRC_PLL1_Q FDCAN1_SEL(1)>;
	pinctrl-0 = <&fdcan1_rx_pa11 &fdcan1_tx_pa12>;
	pinctrl-names = "default";
	bitrate = <500000>;
	status = "okay";
};

/* Reuse the board's existing storage area exclusively for ECU persistent data.
 * Existing boot/image partition offsets and sizes are unchanged.
 */
/ {
	aliases { ecu-nvm = &storage_partition; };
};
```

## boards/native_sim.overlay
```dts
/ {
	aliases { ecu-nvm = &storage_partition; };
};
```

## src/main.c
```c
#include "app_led.h"
#include "app_diag.h"
#include "diag_uds.h"
#include "can_if.h"
#include "can_comm.h"
#include "app_tasks.h"
#include "ecu_task_manager.h"
#if defined(CONFIG_ECU_NVM)
#include "ecu_nvm.h"
#endif

#include <zephyr/logging/log.h>

LOG_MODULE_REGISTER(zephyrecu);

int main(void)
{
	int ret = app_led_init();

	if (ret != 0) {
		LOG_ERR("LED initialization failed: %d", ret);
		return ret;
	}
#if defined(CONFIG_ECU_NVM)
	ret = ecu_nvm_init();
	if (ret != 0) {
		LOG_ERR("Persistent storage initialization failed: %d", ret);
		return ret;
	}
#else
	LOG_WRN("NVM disabled: persistent configuration unavailable on this build");
#endif
	ret = can_if_init();
	if (ret != 0) {
		LOG_ERR("CAN interface initialization failed: %d", ret);
		return ret;
	}
	ret = can_comm_init();
	if (ret == 0) { ret = app_tasks_init(); }
	if (ret != 0) {
		LOG_ERR("Application communication initialization failed: %d", ret);
		return ret;
	}
	ret = diag_uds_init();
	if (ret == 0) {
		ret = app_diag_register();
	}
	if (ret != 0) {
		LOG_ERR("Diagnostic registration failed: %d", ret);
		return ret;
	}
	ret = can_if_start();
	if (ret != 0) {
		LOG_ERR("CAN interface start failed: %d", ret);
		return ret;
	}
	ret = diag_uds_start();
	if (ret != 0) {
		LOG_ERR("Diagnostic worker start failed: %d", ret);
		return ret;
	}
	ret = can_comm_start();
	if (ret == 0) { ret = ecu_task_manager_start(); }
	if (ret != 0) {
		LOG_ERR("Application task startup failed: %d", ret);
		return ret;
	}
	LOG_INF("ZephyrECU CAN and diagnostics ready");
	return 0;
}
```
