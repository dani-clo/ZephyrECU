VERSION "ZephyrECU CI fixtures"
NS_ :

BS_:
BU_: ECU Tester

BO_ 513 Width01: 8 Tester
 SG_ Intel : 1|1@1+ (1,0) [0|1] "" ECU
 SG_ Motorola : 39|1@0- (1,0) [-1|0] "" ECU

BO_ 514 Width02: 8 Tester
 SG_ Intel : 2|2@1+ (1,0) [0|3] "" ECU
 SG_ Motorola : 39|2@0- (1,0) [-2|1] "" ECU

BO_ 515 Width03: 8 Tester
 SG_ Intel : 3|3@1+ (1,0) [0|7] "" ECU
 SG_ Motorola : 39|3@0- (1,0) [-4|3] "" ECU

BO_ 516 Width04: 8 Tester
 SG_ Intel : 4|4@1+ (1,0) [0|15] "" ECU
 SG_ Motorola : 39|4@0- (1,0) [-8|7] "" ECU

BO_ 517 Width05: 8 Tester
 SG_ Intel : 5|5@1+ (1,0) [0|31] "" ECU
 SG_ Motorola : 39|5@0- (1,0) [-16|15] "" ECU

BO_ 518 Width06: 8 Tester
 SG_ Intel : 6|6@1+ (1,0) [0|63] "" ECU
 SG_ Motorola : 39|6@0- (1,0) [-32|31] "" ECU

BO_ 519 Width07: 8 Tester
 SG_ Intel : 7|7@1+ (1,0) [0|127] "" ECU
 SG_ Motorola : 39|7@0- (1,0) [-64|63] "" ECU

BO_ 520 Width08: 8 Tester
 SG_ Intel : 0|8@1+ (1,0) [0|255] "" ECU
 SG_ Motorola : 39|8@0- (1,0) [-128|127] "" ECU

BO_ 521 Width09: 8 Tester
 SG_ Intel : 1|9@1+ (1,0) [0|511] "" ECU
 SG_ Motorola : 39|9@0- (1,0) [-256|255] "" ECU

BO_ 522 Width10: 8 Tester
 SG_ Intel : 2|10@1+ (1,0) [0|1023] "" ECU
 SG_ Motorola : 39|10@0- (1,0) [-512|511] "" ECU

BO_ 523 Width11: 8 Tester
 SG_ Intel : 3|11@1+ (1,0) [0|2047] "" ECU
 SG_ Motorola : 39|11@0- (1,0) [-1024|1023] "" ECU

BO_ 524 Width12: 8 Tester
 SG_ Intel : 4|12@1+ (1,0) [0|4095] "" ECU
 SG_ Motorola : 39|12@0- (1,0) [-2048|2047] "" ECU

BO_ 525 Width13: 8 Tester
 SG_ Intel : 5|13@1+ (1,0) [0|8191] "" ECU
 SG_ Motorola : 39|13@0- (1,0) [-4096|4095] "" ECU

BO_ 526 Width14: 8 Tester
 SG_ Intel : 6|14@1+ (1,0) [0|16383] "" ECU
 SG_ Motorola : 39|14@0- (1,0) [-8192|8191] "" ECU

BO_ 527 Width15: 8 Tester
 SG_ Intel : 7|15@1+ (1,0) [0|32767] "" ECU
 SG_ Motorola : 39|15@0- (1,0) [-16384|16383] "" ECU

BO_ 528 Width16: 8 Tester
 SG_ Intel : 0|16@1+ (1,0) [0|65535] "" ECU
 SG_ Motorola : 39|16@0- (1,0) [-32768|32767] "" ECU

BO_ 529 Width17: 8 Tester
 SG_ Intel : 1|17@1+ (1,0) [0|131071] "" ECU
 SG_ Motorola : 39|17@0- (1,0) [-65536|65535] "" ECU

BO_ 530 Width18: 8 Tester
 SG_ Intel : 2|18@1+ (1,0) [0|262143] "" ECU
 SG_ Motorola : 39|18@0- (1,0) [-131072|131071] "" ECU

BO_ 531 Width19: 8 Tester
 SG_ Intel : 3|19@1+ (1,0) [0|524287] "" ECU
 SG_ Motorola : 39|19@0- (1,0) [-262144|262143] "" ECU

BO_ 532 Width20: 8 Tester
 SG_ Intel : 4|20@1+ (1,0) [0|1048575] "" ECU
 SG_ Motorola : 39|20@0- (1,0) [-524288|524287] "" ECU

BO_ 533 Width21: 8 Tester
 SG_ Intel : 5|21@1+ (1,0) [0|2097151] "" ECU
 SG_ Motorola : 39|21@0- (1,0) [-1048576|1048575] "" ECU

BO_ 534 Width22: 8 Tester
 SG_ Intel : 6|22@1+ (1,0) [0|4194303] "" ECU
 SG_ Motorola : 39|22@0- (1,0) [-2097152|2097151] "" ECU

BO_ 535 Width23: 8 Tester
 SG_ Intel : 7|23@1+ (1,0) [0|8388607] "" ECU
 SG_ Motorola : 39|23@0- (1,0) [-4194304|4194303] "" ECU

BO_ 536 Width24: 8 Tester
 SG_ Intel : 0|24@1+ (1,0) [0|16777215] "" ECU
 SG_ Motorola : 39|24@0- (1,0) [-8388608|8388607] "" ECU

BO_ 537 Width25: 8 Tester
 SG_ Intel : 0|25@1+ (1,0) [0|33554431] "" ECU
 SG_ Motorola : 39|25@0- (1,0) [-16777216|16777215] "" ECU

BO_ 538 Width26: 8 Tester
 SG_ Intel : 0|26@1+ (1,0) [0|67108863] "" ECU
 SG_ Motorola : 39|26@0- (1,0) [-33554432|33554431] "" ECU

BO_ 539 Width27: 8 Tester
 SG_ Intel : 0|27@1+ (1,0) [0|134217727] "" ECU
 SG_ Motorola : 39|27@0- (1,0) [-67108864|67108863] "" ECU

BO_ 540 Width28: 8 Tester
 SG_ Intel : 0|28@1+ (1,0) [0|268435455] "" ECU
 SG_ Motorola : 39|28@0- (1,0) [-134217728|134217727] "" ECU

BO_ 541 Width29: 8 Tester
 SG_ Intel : 0|29@1+ (1,0) [0|536870911] "" ECU
 SG_ Motorola : 39|29@0- (1,0) [-268435456|268435455] "" ECU

BO_ 542 Width30: 8 Tester
 SG_ Intel : 0|30@1+ (1,0) [0|1073741823] "" ECU
 SG_ Motorola : 39|30@0- (1,0) [-536870912|536870911] "" ECU

BO_ 543 Width31: 8 Tester
 SG_ Intel : 0|31@1+ (1,0) [0|2147483647] "" ECU
 SG_ Motorola : 39|31@0- (1,0) [-1073741824|1073741823] "" ECU

BO_ 544 Width32: 8 Tester
 SG_ Intel : 0|32@1+ (1,0) [0|4294967295] "" ECU
 SG_ Motorola : 39|32@0- (1,0) [-2147483648|2147483647] "" ECU
