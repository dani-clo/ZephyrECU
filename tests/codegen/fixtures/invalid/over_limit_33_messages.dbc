VERSION "ZephyrECU CI fixtures"
NS_ :

BS_:
BU_: ECU Tester

BO_ 512 Fixture000: 8 ECU
 SG_ Sig00 : 0|16@1+ (1,0) [0|65535] "" Tester
 SG_ Sig01 : 23|16@0- (1,0) [-32768|32767] "" Tester
 SG_ Sig02 : 32|16@1+ (1,0) [0|65535] "" Tester
 SG_ Sig03 : 55|16@0- (1,0) [-32768|32767] "" Tester

BO_ 513 Fixture001: 8 Tester
 SG_ Sig00 : 0|16@1+ (1,0) [0|65535] "" ECU
 SG_ Sig01 : 23|16@0- (1,0) [-32768|32767] "" ECU
 SG_ Sig02 : 32|16@1+ (1,0) [0|65535] "" ECU
 SG_ Sig03 : 55|16@0- (1,0) [-32768|32767] "" ECU

BO_ 514 Fixture002: 8 ECU
 SG_ Sig00 : 0|16@1+ (1,0) [0|65535] "" Tester
 SG_ Sig01 : 23|16@0- (1,0) [-32768|32767] "" Tester
 SG_ Sig02 : 32|16@1+ (1,0) [0|65535] "" Tester
 SG_ Sig03 : 55|16@0- (1,0) [-32768|32767] "" Tester

BO_ 515 Fixture003: 8 Tester
 SG_ Sig00 : 0|16@1+ (1,0) [0|65535] "" ECU
 SG_ Sig01 : 23|16@0- (1,0) [-32768|32767] "" ECU
 SG_ Sig02 : 32|16@1+ (1,0) [0|65535] "" ECU
 SG_ Sig03 : 55|16@0- (1,0) [-32768|32767] "" ECU

BO_ 516 Fixture004: 8 ECU
 SG_ Sig00 : 0|16@1+ (1,0) [0|65535] "" Tester
 SG_ Sig01 : 23|16@0- (1,0) [-32768|32767] "" Tester
 SG_ Sig02 : 32|16@1+ (1,0) [0|65535] "" Tester
 SG_ Sig03 : 55|16@0- (1,0) [-32768|32767] "" Tester

BO_ 517 Fixture005: 8 Tester
 SG_ Sig00 : 0|16@1+ (1,0) [0|65535] "" ECU
 SG_ Sig01 : 23|16@0- (1,0) [-32768|32767] "" ECU
 SG_ Sig02 : 32|16@1+ (1,0) [0|65535] "" ECU
 SG_ Sig03 : 55|16@0- (1,0) [-32768|32767] "" ECU

BO_ 518 Fixture006: 8 ECU
 SG_ Sig00 : 0|16@1+ (1,0) [0|65535] "" Tester
 SG_ Sig01 : 23|16@0- (1,0) [-32768|32767] "" Tester
 SG_ Sig02 : 32|16@1+ (1,0) [0|65535] "" Tester
 SG_ Sig03 : 55|16@0- (1,0) [-32768|32767] "" Tester

BO_ 519 Fixture007: 8 Tester
 SG_ Sig00 : 0|16@1+ (1,0) [0|65535] "" ECU
 SG_ Sig01 : 23|16@0- (1,0) [-32768|32767] "" ECU
 SG_ Sig02 : 32|16@1+ (1,0) [0|65535] "" ECU
 SG_ Sig03 : 55|16@0- (1,0) [-32768|32767] "" ECU

BO_ 520 Fixture008: 8 ECU
 SG_ Sig00 : 0|16@1+ (1,0) [0|65535] "" Tester
 SG_ Sig01 : 23|16@0- (1,0) [-32768|32767] "" Tester
 SG_ Sig02 : 32|16@1+ (1,0) [0|65535] "" Tester
 SG_ Sig03 : 55|16@0- (1,0) [-32768|32767] "" Tester

BO_ 521 Fixture009: 8 Tester
 SG_ Sig00 : 0|16@1+ (1,0) [0|65535] "" ECU
 SG_ Sig01 : 23|16@0- (1,0) [-32768|32767] "" ECU
 SG_ Sig02 : 32|16@1+ (1,0) [0|65535] "" ECU
 SG_ Sig03 : 55|16@0- (1,0) [-32768|32767] "" ECU

BO_ 522 Fixture010: 8 ECU
 SG_ Sig00 : 0|16@1+ (1,0) [0|65535] "" Tester
 SG_ Sig01 : 23|16@0- (1,0) [-32768|32767] "" Tester
 SG_ Sig02 : 32|16@1+ (1,0) [0|65535] "" Tester
 SG_ Sig03 : 55|16@0- (1,0) [-32768|32767] "" Tester

BO_ 523 Fixture011: 8 Tester
 SG_ Sig00 : 0|16@1+ (1,0) [0|65535] "" ECU
 SG_ Sig01 : 23|16@0- (1,0) [-32768|32767] "" ECU
 SG_ Sig02 : 32|16@1+ (1,0) [0|65535] "" ECU
 SG_ Sig03 : 55|16@0- (1,0) [-32768|32767] "" ECU

BO_ 524 Fixture012: 8 ECU
 SG_ Sig00 : 0|16@1+ (1,0) [0|65535] "" Tester
 SG_ Sig01 : 23|16@0- (1,0) [-32768|32767] "" Tester
 SG_ Sig02 : 32|16@1+ (1,0) [0|65535] "" Tester
 SG_ Sig03 : 55|16@0- (1,0) [-32768|32767] "" Tester

BO_ 525 Fixture013: 8 Tester
 SG_ Sig00 : 0|16@1+ (1,0) [0|65535] "" ECU
 SG_ Sig01 : 23|16@0- (1,0) [-32768|32767] "" ECU
 SG_ Sig02 : 32|16@1+ (1,0) [0|65535] "" ECU
 SG_ Sig03 : 55|16@0- (1,0) [-32768|32767] "" ECU

BO_ 526 Fixture014: 8 ECU
 SG_ Sig00 : 0|16@1+ (1,0) [0|65535] "" Tester
 SG_ Sig01 : 23|16@0- (1,0) [-32768|32767] "" Tester
 SG_ Sig02 : 32|16@1+ (1,0) [0|65535] "" Tester
 SG_ Sig03 : 55|16@0- (1,0) [-32768|32767] "" Tester

BO_ 527 Fixture015: 8 Tester
 SG_ Sig00 : 0|16@1+ (1,0) [0|65535] "" ECU
 SG_ Sig01 : 23|16@0- (1,0) [-32768|32767] "" ECU
 SG_ Sig02 : 32|16@1+ (1,0) [0|65535] "" ECU
 SG_ Sig03 : 55|16@0- (1,0) [-32768|32767] "" ECU

BO_ 528 Fixture016: 8 ECU
 SG_ Sig00 : 0|16@1+ (1,0) [0|65535] "" Tester
 SG_ Sig01 : 23|16@0- (1,0) [-32768|32767] "" Tester
 SG_ Sig02 : 32|16@1+ (1,0) [0|65535] "" Tester
 SG_ Sig03 : 55|16@0- (1,0) [-32768|32767] "" Tester

BO_ 529 Fixture017: 8 Tester
 SG_ Sig00 : 0|16@1+ (1,0) [0|65535] "" ECU
 SG_ Sig01 : 23|16@0- (1,0) [-32768|32767] "" ECU
 SG_ Sig02 : 32|16@1+ (1,0) [0|65535] "" ECU
 SG_ Sig03 : 55|16@0- (1,0) [-32768|32767] "" ECU

BO_ 530 Fixture018: 8 ECU
 SG_ Sig00 : 0|16@1+ (1,0) [0|65535] "" Tester
 SG_ Sig01 : 23|16@0- (1,0) [-32768|32767] "" Tester
 SG_ Sig02 : 32|16@1+ (1,0) [0|65535] "" Tester
 SG_ Sig03 : 55|16@0- (1,0) [-32768|32767] "" Tester

BO_ 531 Fixture019: 8 Tester
 SG_ Sig00 : 0|16@1+ (1,0) [0|65535] "" ECU
 SG_ Sig01 : 23|16@0- (1,0) [-32768|32767] "" ECU
 SG_ Sig02 : 32|16@1+ (1,0) [0|65535] "" ECU
 SG_ Sig03 : 55|16@0- (1,0) [-32768|32767] "" ECU

BO_ 532 Fixture020: 8 ECU
 SG_ Sig00 : 0|16@1+ (1,0) [0|65535] "" Tester
 SG_ Sig01 : 23|16@0- (1,0) [-32768|32767] "" Tester
 SG_ Sig02 : 32|16@1+ (1,0) [0|65535] "" Tester
 SG_ Sig03 : 55|16@0- (1,0) [-32768|32767] "" Tester

BO_ 533 Fixture021: 8 Tester
 SG_ Sig00 : 0|16@1+ (1,0) [0|65535] "" ECU
 SG_ Sig01 : 23|16@0- (1,0) [-32768|32767] "" ECU
 SG_ Sig02 : 32|16@1+ (1,0) [0|65535] "" ECU
 SG_ Sig03 : 55|16@0- (1,0) [-32768|32767] "" ECU

BO_ 534 Fixture022: 8 ECU
 SG_ Sig00 : 0|16@1+ (1,0) [0|65535] "" Tester
 SG_ Sig01 : 23|16@0- (1,0) [-32768|32767] "" Tester
 SG_ Sig02 : 32|16@1+ (1,0) [0|65535] "" Tester
 SG_ Sig03 : 55|16@0- (1,0) [-32768|32767] "" Tester

BO_ 535 Fixture023: 8 Tester
 SG_ Sig00 : 0|16@1+ (1,0) [0|65535] "" ECU
 SG_ Sig01 : 23|16@0- (1,0) [-32768|32767] "" ECU
 SG_ Sig02 : 32|16@1+ (1,0) [0|65535] "" ECU
 SG_ Sig03 : 55|16@0- (1,0) [-32768|32767] "" ECU

BO_ 536 Fixture024: 8 ECU
 SG_ Sig00 : 0|16@1+ (1,0) [0|65535] "" Tester
 SG_ Sig01 : 23|16@0- (1,0) [-32768|32767] "" Tester
 SG_ Sig02 : 32|16@1+ (1,0) [0|65535] "" Tester
 SG_ Sig03 : 55|16@0- (1,0) [-32768|32767] "" Tester

BO_ 537 Fixture025: 8 Tester
 SG_ Sig00 : 0|16@1+ (1,0) [0|65535] "" ECU
 SG_ Sig01 : 23|16@0- (1,0) [-32768|32767] "" ECU
 SG_ Sig02 : 32|16@1+ (1,0) [0|65535] "" ECU
 SG_ Sig03 : 55|16@0- (1,0) [-32768|32767] "" ECU

BO_ 538 Fixture026: 8 ECU
 SG_ Sig00 : 0|16@1+ (1,0) [0|65535] "" Tester
 SG_ Sig01 : 23|16@0- (1,0) [-32768|32767] "" Tester
 SG_ Sig02 : 32|16@1+ (1,0) [0|65535] "" Tester
 SG_ Sig03 : 55|16@0- (1,0) [-32768|32767] "" Tester

BO_ 539 Fixture027: 8 Tester
 SG_ Sig00 : 0|16@1+ (1,0) [0|65535] "" ECU
 SG_ Sig01 : 23|16@0- (1,0) [-32768|32767] "" ECU
 SG_ Sig02 : 32|16@1+ (1,0) [0|65535] "" ECU
 SG_ Sig03 : 55|16@0- (1,0) [-32768|32767] "" ECU

BO_ 540 Fixture028: 8 ECU
 SG_ Sig00 : 0|16@1+ (1,0) [0|65535] "" Tester
 SG_ Sig01 : 23|16@0- (1,0) [-32768|32767] "" Tester
 SG_ Sig02 : 32|16@1+ (1,0) [0|65535] "" Tester
 SG_ Sig03 : 55|16@0- (1,0) [-32768|32767] "" Tester

BO_ 541 Fixture029: 8 Tester
 SG_ Sig00 : 0|16@1+ (1,0) [0|65535] "" ECU
 SG_ Sig01 : 23|16@0- (1,0) [-32768|32767] "" ECU
 SG_ Sig02 : 32|16@1+ (1,0) [0|65535] "" ECU
 SG_ Sig03 : 55|16@0- (1,0) [-32768|32767] "" ECU

BO_ 542 Fixture030: 8 ECU
 SG_ Sig00 : 0|16@1+ (1,0) [0|65535] "" Tester
 SG_ Sig01 : 23|16@0- (1,0) [-32768|32767] "" Tester
 SG_ Sig02 : 32|16@1+ (1,0) [0|65535] "" Tester
 SG_ Sig03 : 55|16@0- (1,0) [-32768|32767] "" Tester

BO_ 543 Fixture031: 8 Tester
 SG_ Sig00 : 0|16@1+ (1,0) [0|65535] "" ECU
 SG_ Sig01 : 23|16@0- (1,0) [-32768|32767] "" ECU
 SG_ Sig02 : 32|16@1+ (1,0) [0|65535] "" ECU
 SG_ Sig03 : 55|16@0- (1,0) [-32768|32767] "" ECU

BO_ 544 Fixture032: 8 ECU
 SG_ Sig00 : 0|16@1+ (1,0) [0|65535] "" Tester
 SG_ Sig01 : 23|16@0- (1,0) [-32768|32767] "" Tester
 SG_ Sig02 : 32|16@1+ (1,0) [0|65535] "" Tester
 SG_ Sig03 : 55|16@0- (1,0) [-32768|32767] "" Tester
