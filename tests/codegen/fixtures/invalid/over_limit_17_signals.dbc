VERSION "ZephyrECU CI fixtures"
NS_ :

BS_:
BU_: ECU Tester

BO_ 291 Malformed: 8 Tester
 SG_ S0 : 0|1@1+ (1,0) [0|1] "" ECU
 SG_ S1 : 1|1@1+ (1,0) [0|1] "" ECU
 SG_ S2 : 2|1@1+ (1,0) [0|1] "" ECU
 SG_ S3 : 3|1@1+ (1,0) [0|1] "" ECU
 SG_ S4 : 4|1@1+ (1,0) [0|1] "" ECU
 SG_ S5 : 5|1@1+ (1,0) [0|1] "" ECU
 SG_ S6 : 6|1@1+ (1,0) [0|1] "" ECU
 SG_ S7 : 7|1@1+ (1,0) [0|1] "" ECU
 SG_ S8 : 8|1@1+ (1,0) [0|1] "" ECU
 SG_ S9 : 9|1@1+ (1,0) [0|1] "" ECU
 SG_ S10 : 10|1@1+ (1,0) [0|1] "" ECU
 SG_ S11 : 11|1@1+ (1,0) [0|1] "" ECU
 SG_ S12 : 12|1@1+ (1,0) [0|1] "" ECU
 SG_ S13 : 13|1@1+ (1,0) [0|1] "" ECU
 SG_ S14 : 14|1@1+ (1,0) [0|1] "" ECU
 SG_ S15 : 15|1@1+ (1,0) [0|1] "" ECU
 SG_ S16 : 16|1@1+ (1,0) [0|1] "" ECU
