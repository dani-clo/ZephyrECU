VERSION "ZephyrECU CI fixtures"
NS_ :

BS_:
BU_: ECU Tester

BO_ 291 Malformed: 8 Tester
 SG_ Value : 0|8@1+ (1,0) [0|255] "" ECU

BO_ 291 Other: 1 Tester
 SG_ Value : 0|8@1+ (1,0) [0|255] "" ECU
