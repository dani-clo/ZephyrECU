VERSION "ZephyrECU CI fixtures"
NS_ :

BS_:
BU_: ECU Tester

BO_ 291 Malformed: 8 Tester
 SG_ FooBar : 0|8@1+ (1,0) [0|255] "" ECU
 SG_ Foo_bar : 8|8@1+ (1,0) [0|255] "" ECU
