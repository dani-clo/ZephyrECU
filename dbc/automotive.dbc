VERSION "ZephyrECU demo"
NS_ :

BS_:
BU_: ECU Tester

BO_ 288 LedCommand: 4 Tester
 SG_ LedRequest : 0|1@1+ (1,0) [0|1] "" ECU
 SG_ Demand : 15|12@0- (0.1,0) [-100|100] "unit" ECU

BO_ 2566848769 VehicleFeedback: 8 Tester
 SG_ Counter : 0|32@1+ (1,0) [0|4294967295] "" ECU
 SG_ Temperature : 39|12@0- (0.5,-40) [-1064|983.5] "degC" ECU

BO_ 544 StatusPeriodic: 2 ECU
 SG_ LedStatus : 0|1@1+ (1,0) [0|1] "" Tester
 SG_ Counter : 8|8@1+ (1,0) [0|255] "" Tester

BO_ 545 StatusEvent: 3 ECU
 SG_ EventValue : 7|16@0- (0.25,-10) [-8202|8181.75] "unit" Tester
 SG_ EventCount : 16|8@1+ (1,0) [0|255] "" Tester

BO_ 546 StatusMixed: 3 ECU
 SG_ MixedValue : 0|12@1+ (2,1) [1|8191] "unit" Tester
 SG_ PendingFlag : 16|1@1+ (1,0) [0|1] "" Tester
